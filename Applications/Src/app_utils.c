/* Includes ------------------------------------------------------------------*/
#include "app_utils.h"

const uint8_t BitReverseTable[] =
{
  0x00, 0x80, 0x40, 0xC0, 0x20, 0xA0, 0x60, 0xE0, 0x10, 0x90, 0x50, 0xD0, 0x30, 0xB0, 0x70, 0xF0,
  0x08, 0x88, 0x48, 0xC8, 0x28, 0xA8, 0x68, 0xE8, 0x18, 0x98, 0x58, 0xD8, 0x38, 0xB8, 0x78, 0xF8,
  0x04, 0x84, 0x44, 0xC4, 0x24, 0xA4, 0x64, 0xE4, 0x14, 0x94, 0x54, 0xD4, 0x34, 0xB4, 0x74, 0xF4,
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  0x0F, 0x8F, 0x4F, 0xCF, 0x2F, 0xAF, 0x6F, 0xEF, 0x1F, 0x9F, 0x5F, 0xDF, 0x3F, 0xBF, 0x7F, 0xFF
};

/* Private typedef -----------------------------------------------------------*/
//打印输出时的背景色/前景色定义(需要电脑打印终端支持)
typedef enum
{
	bg_black = 40,        //黑
	bg_red,               //红
	bg_green,             //绿
	bg_yellow,            //黄
	bg_blue,              //蓝
	bg_purple,            //紫
	bg_dark_green,        //深绿
	bg_write              //白色
}LOG_PRINT_BG_COLOR;

typedef enum
{
	front_black = 30,      //黑
	front_red,             //红
	front_green,           //绿
	front_yellow,          //黄
	front_blue,            //蓝
	front_purple,          //紫
	front_dark_green,      //深绿
	front_write            //白色
}LOG_PRINT_FRONT_COLOR;

/* Private define ------------------------------------------------------------*/

/* Private macro -------------------------------------------------------------*/

/* Private variables ---------------------------------------------------------*/
static LOG_PRINT_TYPE print_level = __NULL__;
/* Private function prototypes -----------------------------------------------*/

#ifdef __GNUC__
/* With GCC, small printf (option LD Linker->Libraries->Small printf
   set to 'Yes') calls __io_putchar() */
#define PUTCHAR_PROTOTYPE int __io_putchar(int ch)
//#define GETCHAR_PROTOTYPE int __io_getchar(FILE *stream)
#else
#define PUTCHAR_PROTOTYPE int fputc(int ch, FILE *f)
//#define GETCHAR_PROTOTYPE int fgetc(FILE *stream)
#endif /* __GNUC__ */

/* Private functions ---------------------------------------------------------*/

/* Exported functions --------------------------------------------------------*/
uint8_t u8UTILS_BitReverse(uint8_t data)
{
	data = (data & 0xaa) >> 1 | (data & 0x55) << 1;
	data = (data & 0xcc) >> 2 | (data & 0x33) << 2;
	data = (data & 0xf0) >> 4 | (data & 0x0f) << 4;
	return data;
}

uint32_t u32UTILS_BitReverse(uint32_t data)
{
    data = (data & 0x55555555) <<  1 | (data & 0xAAAAAAAA) >>  1;
    data = (data & 0x33333333) <<  2 | (data & 0xCCCCCCCC) >>  2;
    data = (data & 0x0F0F0F0F) <<  4 | (data & 0xF0F0F0F0) >>  4;
    data = (data & 0x00FF00FF) <<  8 | (data & 0xFF00FF00) >>  8;
    data = (data & 0x0000FFFF) << 16 | (data & 0xFFFF0000) >> 16;
    return data;
}


uint8_t u8UTILS_GetCheckSum(uint8_t *pBuf,uint16_t len)
{
  uint16_t tmp,ix;

  tmp = pBuf[0];

  for (ix = 1; ix < len; ++ix)
          tmp += pBuf[ix];

  return tmp;
}

uint8_t u8UTILS_GetCheckXor(uint8_t *pBuf,uint16_t len)
{
  uint16_t tmp,ix;

  tmp = pBuf[0];
  for (ix = 1; ix < len; ++ix) 
          tmp ^= pBuf[ix];

  return tmp&0xFF;
}

uint16_t u16UTILS_GetCheckSum(uint16_t *pBuf,uint16_t len)
{
  uint16_t tmp,ix;

  tmp = pBuf[0];

  for (ix = 1; ix < len; ++ix)
          tmp += pBuf[ix];

  return tmp;
}

uint16_t u16UTILS_GetCheckXor(uint16_t *pBuf,uint16_t len)
{
  uint16_t tmp,ix;

  tmp = pBuf[0];
  for (ix = 1; ix < len; ++ix) 
          tmp ^= pBuf[ix];

  return tmp&0xFFFF;
}

uint32_t u32UTILS_GetCheckSum(uint32_t *pBuf,uint32_t len)
{
  uint32_t tmp,ix;

  tmp = pBuf[0];

  for (ix = 1; ix < len; ++ix)
          tmp += pBuf[ix];

  return tmp;
}

uint32_t u32UTILS_GetCheckXor(uint32_t *pBuf,uint32_t len)
{
  uint32_t tmp,ix;

  tmp = pBuf[0];
  for (ix = 1; ix < len; ++ix) 
          tmp ^= pBuf[ix];

  return tmp&0xFFFFFFFF;
}

static const uint8_t auchCRCHi[] = { 
  0x00, 0xC1, 0x81, 0x40, 0x01, 0xC0, 0x80, 0x41, 0x01, 0xC0, 
  0x80, 0x41, 0x00, 0xC1, 0x81, 0x40, 0x01, 0xC0, 0x80, 0x41, 
  0x00, 0xC1, 0x81, 0x40, 0x00, 0xC1, 0x81, 0x40, 0x01, 0xC0, 
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  0x80, 0x41, 0x00, 0xC1, 0x81, 0x40 
};
static const uint8_t auchCRCLo[] = { 
  0x00, 0xC0, 0xC1, 0x01, 0xC3, 0x03, 0x02, 0xC2, 0xC6, 0x06, 
  0x07, 0xC7, 0x05, 0xC5, 0xC4, 0x04, 0xCC, 0x0C, 0x0D, 0xCD, 
  0x0F, 0xCF, 0xCE, 0x0E, 0x0A, 0xCA, 0xCB, 0x0B, 0xC9, 0x09, 
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  0x43, 0x83, 0x41, 0x81, 0x80, 0x40
} ;

uint16_t u16UTILS_GetCheckCrcModbusRTU(uint8_t *puchMsg, uint16_t usDataLen) //ModbusRTU
{ 
  uint8_t uchCRCHi = 0xFF;
  uint8_t uchCRCLo = 0xFF;
  uint16_t uIndex;
  while (usDataLen--)	{
   
          uIndex = uchCRCLo ^ ((*puchMsg)&0xFF); puchMsg++;
          uchCRCLo = uchCRCHi ^ auchCRCHi[uIndex]; 
          uchCRCHi = auchCRCLo[uIndex]; 
  } 
  return (uchCRCHi << 8 | uchCRCLo); 
}

/*=============================================================
 * tx_data[] = {0x02, 0x03, 0x00, 0x00, 0x00, 0x01};
 * uint16_t crc;
 * uint8_t  crcH, crcL;
 * crc = u16UTILS_GetCheckCrc(tx_data, 6);
 * crcH = crc >> 8;
 * crrL = crc & 0xFF;
 *===========================================================*/
// CRC Table
const unsigned short crc16_tab[] = { 0x0000, 0x1021, 0x2042, 0x3063, 0x4084,
		0x50a5, 0x60c6, 0x70e7, 0x8108, 0x9129, 0xa14a, 0xb16b, 0xc18c, 0xd1ad,
		0xe1ce, 0xf1ef, 0x1231, 0x0210, 0x3273, 0x2252, 0x52b5, 0x4294, 0x72f7,
		0x62d6, 0x9339, 0x8318, 0xb37b, 0xa35a, 0xd3bd, 0xc39c, 0xf3ff, 0xe3de,
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		0x6e17, 0x7e36, 0x4e55, 0x5e74, 0x2e93, 0x3eb2, 0x0ed1, 0x1ef0 };


uint16_t u16UTILS_GetCheckCrc16(unsigned char *buf, unsigned int len) {
	unsigned int i;
	unsigned short cksum = 0;
	for (i = 0; i < len; i++) {
		cksum = crc16_tab[(((cksum >> 8) ^ *buf++) & 0xFF)] ^ (cksum << 8);
	}
	return cksum;
}

/**
  * @brief  Retargets the C library printf function to the USART.
  * @param  None
  * @retval None
  */
PUTCHAR_PROTOTYPE
{
  /* Place your implementation of fputc here */
  /* e.g. write a character to the USART3 and Loop until the end of transmission */
//  extern UART_HandleTypeDef huart3;
//  UNUSED(__HAL_UART_GET_FLAG(&huart3, UART_FLAG_TC));//bug.
//  HAL_UART_Transmit(&huart3, (uint8_t *)&ch, 1, 0xFFFF);
//  ITM_SendChar(ch);
  return ch;
}
//
//GETCHAR_PROTOTYPE
//{
//  uint8_t ch = 0;
//  extern UART_HandleTypeDef huart3;
//  HAL_UART_Receive(&huart3,(uint8_t *)&ch, 1, 0xFFFF);
//  if (ch == '\r'){
//      __io_putchar('\r');
//      ch = '\n';
//  }
//
//  return __io_putchar(ch);
////  return ch;
//}
/******************************************************************************************
*                                     DPRINT
* Description : 打印模块,可根据信息级别进行打印输出
* Argument(s) : DPRINT_TYPE type   : 打印信息类型
*               const char* format: 打印信息内容,与printf使用方法一致
* Returns     : None
******************************************************************************************/
void vUTILS_LOG_PRINT(LOG_PRINT_TYPE type, const char* format, ...)
{
	va_list ap;
	char s[LOG_PRINT_MAXSTRLEN];
	char* infotype = NULL;

	if (type < print_level)		//打印信息等级低于设定级别,则不打印
		return;

	va_start(ap, format);
	vsprintf(s, format, ap);
	va_end(ap);

	LOG_PRINT_BG_COLOR    bg_color = bg_black;
	LOG_PRINT_FRONT_COLOR front_color = front_write;

	switch (type)
	{
	case __NULL__:  infotype = "";          break;
	case __DEBUG__: infotype = "[DEBUG]: "; break;
	case __INFO__:  infotype = "[INFO ]: "; break;
	case __WARN__:  infotype = "[WARN ]: "; front_color = front_yellow; break;
	case __ERROR__: infotype = "[ERROR]: "; front_color = front_red;	break;
	case __FATAL__: infotype = "[FATAL]: "; front_color = front_purple;	break;
	default:        infotype = "[USER ]: "; break;
	}

#if(LOG_PRINT_COLOR_SUPPORT==1)
	printf("\033[0;%d;%dm%s%s\033[0m", front_color, bg_color, infotype, s);
#else
	front_color = front_color;   //无意义,只用于消除编译器警告(unused)
	bg_color = bg_color;
	printf("%s%s", infotype, s);
#endif
}

void vUTILS_LOG_PRINT_LEVEL_SET(LOG_PRINT_TYPE level)
{
	print_level = level;
}
